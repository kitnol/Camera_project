## main/Kconfig.projbuild
```kconfig
menu "Example Configuration"

    config CONSOLE_STORE_HISTORY
        bool "Store command history in flash"
        default y
        help
            Linenoise line editing library provides functions to save and load
            command history. If this option is enabled, initalizes a FAT filesystem
            and uses it to store command history.

    config CONSOLE_MAX_COMMAND_LINE_LENGTH
        int "Maximum command line length"
        default 1024
        help
            This value marks the maximum length of a single command line. Once it is
            reached, no more characters will be accepted by the console.
     config EXAMPLE_USED_LDO_CHAN_ID
        int "Occupied channel ID of the LDO to power on the MIPI DSI PHY"
        default 3
        help
            Example used LDO channel ID, you may check datasheet to know more details.

    config EXAMPLE_USED_LDO_VOLTAGE_MV
        int "Occupied LDO voltage in mV"
        default 2500
        range 0 3300
        help
            Example used LDO voltage, in mV

    config EXAMPLE_CAM_PORT_ISP_DVP
        bool
        default y

    config CAMERA_PSRAM_DMA
        bool "Enable PSRAM DMA mode by default"
        depends on IDF_TARGET_ESP32S2 || IDF_TARGET_ESP32S3
        default n
        help
            Enable DMA transfers directly from PSRAM on supported targets
            (ESP32-S2 and ESP32-S3) by default.


    choice EXAMPLE_CAM_HRES
        bool "Set camera horizontal resolution"
        default EXAMPLE_CAM_HRES_1024 if EXAMPLE_MIPI_DSI_DISP_HRES_1024
        default EXAMPLE_CAM_HRES_800 if EXAMPLE_MIPI_DSI_DISP_HRES_800

        config EXAMPLE_CAM_HRES_1024
            depends on EXAMPLE_MIPI_DSI_DISP_HRES_1024
            bool "1024"
        config EXAMPLE_CAM_HRES_800
            depends on EXAMPLE_MIPI_DSI_DISP_HRES_800
            bool "800"
    endchoice

    config EXAMPLE_CAM_HRES
        int
        default 1024 if EXAMPLE_CAM_HRES_1024
        default 800 if EXAMPLE_CAM_HRES_800

    choice EXAMPLE_CAM_VRES
        bool "Set camera vertical resolution"
        default EXAMPLE_CAM_VRES_600 if EXAMPLE_MIPI_DSI_DISP_VRES_600
        default EXAMPLE_CAM_VRES_640 if EXAMPLE_MIPI_DSI_DISP_VRES_1280

        config EXAMPLE_CAM_VRES_600
            depends on EXAMPLE_MIPI_DSI_DISP_VRES_600
            bool "600"
        config EXAMPLE_CAM_VRES_640
            depends on EXAMPLE_MIPI_DSI_DISP_VRES_1280
            bool "640"
        config EXAMPLE_CAM_VRES_800
            depends on EXAMPLE_MIPI_DSI_DISP_VRES_1280
            bool "800"
    endchoice

    choice EXAMPLE_CAM_INPUT_FORMAT
        bool "Set camera input format"
        default EXAMPLE_CAM_INPUT_FORMAT_YUV422

        config EXAMPLE_CAM_INPUT_FORMAT_RGB565
            bool "RGB565"
        config EXAMPLE_CAM_INPUT_FORMAT_YUV422
            bool "YUV422"
    endchoice
endmenu
```
